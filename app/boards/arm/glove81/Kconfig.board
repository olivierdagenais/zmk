## app/boards/arm/glove81/Kconfig.board
```kconfig
# Copyright (c) 2021 The ZMK Contributors
# SPDX-License-Identifier: MIT

config BOARD_GLOVE81_LH
    bool "Glove81 LH"
    depends on SOC_NRF52840_QIAA

config BOARD_GLOVE81_RH
    bool "Glove81 RH"
    depends on SOC_NRF52840_QIAA
```
